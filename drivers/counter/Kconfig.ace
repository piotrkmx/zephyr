## drivers/counter/Kconfig.ace
```kconfig
# Copyright (c) 2022 Intel Corporation
#
# SPDX-License-Identifier: Apache-2.0

config ACE_V1X_ART_COUNTER
	bool "DSP ART Wall Clock for ACE V1X"
	default y
	help
	  DSP ART Wall Clock used by ACE V1X.

config ACE_V1X_RTC_COUNTER
	bool "DSP RTC Wall Clock for ACE V1X"
	default y
	help
	  DSP RTC Wall Clock used by ACE V1X.
```
